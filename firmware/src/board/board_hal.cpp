// What every board shares of BoardHal (board/board_hal.h).
#include "board/board_hal.h"

#include <Arduino.h>
#include <Preferences.h>
#include <esp_heap_caps.h>
#include <esp_random.h>

#include "board/config.h"
#include "board/display.h"
#include "board/touch.h"
#include "boop_version.h"  // generated by firmware/tools/version.py
#include "linkkit/ble.h"

namespace board {

namespace {
constexpr const char* kNvsSpace = "boop";
// The touch calibration with the screen it was fitted on (app::SavedTouchCal).
constexpr const char* kNvsTouchCal = "touchcal2";
}  // namespace

void BoardHal::begin() {
  beginBoard();
  Preferences nvs;
  if (nvs.begin(kNvsSpace, false)) {
    app::SavedTouchCal saved;
    size_t n = nvs.isKey(kNvsTouchCal) ? nvs.getBytes(kNvsTouchCal, &saved, sizeof(saved)) : 0;
    app::TouchCal c;
    if (app::loadTouchCal(&saved, n, kRotation, c)) cal_ = c;
    nvs.end();
  }
}

const char* BoardHal::fwVersion() { return BOOP_FW_VERSION; }

// Picked once, from the radio's true random numbers (LinkKit SPEC §5).
uint32_t BoardHal::bootId() {
  static const uint32_t id = esp_random() | 1;
  return id;
}
const char* BoardHal::gitSha() { return BOOP_GIT_SHA; }

const char* BoardHal::deviceId() { return ble_ ? ble_->id() : Hal::deviceId(); }
const char* BoardHal::bleState() { return ble_ ? ble_->state() : "off"; }
const char* BoardHal::bleName() { return ble_ ? ble_->name() : ""; }

uint32_t BoardHal::realMs() { return millis(); }

bool BoardHal::bootDown() { return digitalRead(pins::kMainButton) == LOW; }

bool BoardHal::touch(int& x, int& y) {
  int rx, ry, rz;
  bool irq;
  board::touchRaw(rx, ry, rz, irq);
  if (!irq || rz <= 0) return false;
  (cal_.valid ? cal_ : defaultCal_).map(rx, ry, x, y);
  return true;
}

void BoardHal::touchRaw(int& x, int& y, int& z, bool& irq) { board::touchRaw(x, y, z, irq); }

void BoardHal::setTouchCal(const app::TouchCal& c) {
  cal_ = c;
  Preferences nvs;
  if (!nvs.begin(kNvsSpace, false)) return;
  if (c.valid) {
    app::SavedTouchCal saved = app::saveTouchCal(c, kRotation);
    nvs.putBytes(kNvsTouchCal, &saved, sizeof(saved));
  } else {
    nvs.remove(kNvsTouchCal);
  }
  nvs.end();
}

void BoardHal::setBacklight(uint8_t level) { displayBacklight(level); }

render::Size BoardHal::nativeSize() { return {kNativeWidth, kNativeHeight}; }
// In PSRAM: the AMOLED's two native surfaces are 411 KB each. The CYD asks for none.
void* BoardHal::allocateSurface(size_t bytes) { return heap_caps_calloc(1, bytes, MALLOC_CAP_SPIRAM | MALLOC_CAP_8BIT); }

// Internal RAM only: the AMOLED's 8 MB of PSRAM, where its surfaces live,
// would hide what the heap budget is about. The CYD has
// nothing else.
constexpr uint32_t kHeapCaps = MALLOC_CAP_INTERNAL | MALLOC_CAP_8BIT;

uint32_t BoardHal::heapFree() { return heap_caps_get_free_size(kHeapCaps); }

uint32_t BoardHal::heapMin() { return heap_caps_get_minimum_free_size(kHeapCaps); }

}  // namespace board
